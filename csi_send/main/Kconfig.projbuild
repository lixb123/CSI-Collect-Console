## csi_send/main/Kconfig.projbuild
```kconfig
menu "Research CSI transmitter"

config RESEARCH_TX_SOFTAP_MODE
    bool "Run as SoftAP CSI transmitter"
    default y
    help
        Build this ESP32-S3 as a Wi-Fi SoftAP instead of an ESP-NOW STA.
        The existing receiver firmware can connect to this SSID and use its
        router-ping CSI workflow without a receiver firmware update.

config RESEARCH_TX_SOFTAP_SSID
    string "SoftAP SSID"
    default "ESP32S3-CSI-AP"
    depends on RESEARCH_TX_SOFTAP_MODE

config RESEARCH_TX_SOFTAP_PASSWORD
    string "SoftAP WPA2 password"
    default "csi-research"
    depends on RESEARCH_TX_SOFTAP_MODE
    help
        Use at least 8 characters for WPA2. Shorter values create an open AP.

config RESEARCH_TX_EXPERIMENT_ID
    string "Default experiment ID"
    default "UNSET"
    help
        Compact pseudonymous experiment/session identifier. Runtime changes are
        available through the research_tx console command.

config RESEARCH_TX_SEND_INTERVAL_MS
    int "Default send interval (ms)"
    range 1 60000
    default 10

config RESEARCH_TX_PAYLOAD_LENGTH
    int "Research application payload length (bytes)"
    range 0 186
    default 32

config RESEARCH_TX_CHANNEL
    int "2.4 GHz Wi-Fi channel"
    range 1 13
    default 11

config RESEARCH_TX_AUTOSTART
    bool "Start transmitting automatically after boot"
    default y

endmenu
```

## main/Kconfig.projbuild
```kconfig
menu "Research CSI receiver"

config RESEARCH_RX_ESPNOW_MODE
    bool "Use the external research ESP-NOW transmitter"
    default n
    help
        Keep the CSI source-MAC filter on 1a:00:00:00:00:00 and do not start
        the receiver's legacy router-ping/null-data traffic generator. Disable
        this option to retain the legacy router-triggered CSI workflow.

config RESEARCH_RX_NULL_DATA_MODE
    bool "Use high-rate null-data CSI trigger for connected APs"
    default n
    depends on !RESEARCH_RX_ESPNOW_MODE
    help
        Send an 802.11 null-data frame every configured CSI interval after the
        station connects. The access point ACKs the frame, creating a
        high-rate CSI source for normal routers and the optional ESP32 SoftAP.
        ESP-NOW mode disables this setting and retains its dedicated workflow.

endmenu
```
